// SPDX-License-Identifier: (GPL-2.0 OR MIT)

#include "ipq9554-jiorouter-ax6000-jidu6111.dts"

&wifi0 {
	status = "disabled";
};

&q6v5_wcss {
	status = "disabled";
};

&q6_region {
	status = "disabled";
};
